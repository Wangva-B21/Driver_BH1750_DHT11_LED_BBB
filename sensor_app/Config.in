## sensor_app/Config.in
```kconfig
config BR2_PACKAGE_SENSOR_APP
    bool "sensor_app"
    help
      A package containing BH1750, DHT11, and LED applications.
```

## sensor_autostart/Config.in
```kconfig
config BR2_PACKAGE_SENSOR_AUTOSTART
    bool "sensor_autostart"
    help
      This package installs a script to auto-start sensor apps on BBB.
```

## sensor_driver/Config.in
```kconfig
config BR2_PACKAGE_SENSOR_DRIVER
    bool "sensor_driver"
    help
      Build sensor kernel modules (bh1750, dht11, led drivers).
```
